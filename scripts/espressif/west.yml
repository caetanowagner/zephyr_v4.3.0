## scripts/espressif/west.yml
```yaml
manifest:
  remotes:
    - name: upstream
      url-base: https://github.com/zephyrproject-rtos

  projects:
    - name: zephyr
      remote: upstream
      revision: v4.3.0
      path: deps/zephyr
      import:
        name-allowlist:
          - acpica
          - edtt
          - fatfs
          - hal_espressif
          - hal_xtensa
          - hostap
          - liblc3
          - littlefs
          - loramac-node
          - lvgl
          - mbedtls
          - mcuboot
          - mipi-sys-t
          - net-tools
          - openthread
          - percepio
          - picolibc
          - segger
          - tinycrypt
          - uoscore-uedhoc
          - zcbor

  self:
    path: .
```
